## esp32/components/muse/Kconfig
```kconfig
# Copyright (c) Meta Platforms, Inc. and affiliates.
#
# Licensed under the Apache License, Version 2.0 (the "License");
# you may not use this file except in compliance with the License.
# You may obtain a copy of the License at
#
#     http://www.apache.org/licenses/LICENSE-2.0
#
# Unless required by applicable law or agreed to in writing, software
# distributed under the License is distributed on an "AS IS" BASIS,
# WITHOUT WARRANTIES OR CONDITIONS OF ANY KIND, either express or implied.
# See the License for the specific language governing permissions and
# limitations under the License.

menu "Muse"

    choice MUSE_BOARD
        prompt "Board with the full UI"
        default MUSE_BOARD_NONE
        help
            The UI is the voice companion on boards with a screen: an
            animated avatar, push-to-talk chat, settings, and battery
            handling. It runs beside Home Link, which owns Wi-Fi, BLE
            pairing, credentials and OTA. Pick the board it runs on, or none
            for a Link without a display.

        config MUSE_BOARD_NONE
            bool "None (Home Link without a display)"

        config MUSE_BOARD_WAVESHARE_S3_175C
            bool "Waveshare ESP32-S3-Touch-AMOLED-1.75C"
            depends on IDF_TARGET_ESP32S3

        config MUSE_BOARD_WAVESHARE_S3_175
            bool "Waveshare ESP32-S3-Touch-AMOLED-1.75 (not the 1.75C)"
            depends on IDF_TARGET_ESP32S3

        config MUSE_BOARD_ATK_DNESP32S3_BOX0
            bool "Alientek ATK-DNESP32S3-BOX0 (240x240 LCD, ES8311)"
            depends on IDF_TARGET_ESP32S3

        config MUSE_BOARD_AIPI
            bool "AIPI Lite (ESP32-S3, two buttons, no touch)"
            depends on IDF_TARGET_ESP32S3

        config MUSE_BOARD_ESPRESSIF_BOX_3
            bool "Espressif ESP32-S3-BOX-3 (320x240 touch LCD, speaker and microphones)"
            depends on IDF_TARGET_ESP32S3

        config MUSE_BOARD_WAVESHARE_C6_18
            bool "Waveshare ESP32-C6-Touch-AMOLED-1.8"
            depends on IDF_TARGET_ESP32C6

        config MUSE_BOARD_SENSECAP_WATCHER
            bool "Seeed SenseCAP Watcher (ESP32-S3, round touch LCD, wheel)"
            depends on IDF_TARGET_ESP32S3

        config MUSE_BOARD_M5STACK_CARDPUTER_ADV
            bool "M5Stack Cardputer ADV (ESP32-S3, keyboard, no PSRAM)"
            depends on IDF_TARGET_ESP32S3

        config MUSE_BOARD_M5STACK_STICKS3
            bool "M5Stack StickS3 (ESP32-S3, two buttons, no touch)"
            depends on IDF_TARGET_ESP32S3

        config MUSE_BOARD_M5STACK_STICKC_PLUS2
            bool "M5Stack StickC Plus2 (ESP32, two buttons, no touch)"
            depends on IDF_TARGET_ESP32

        config MUSE_BOARD_M5STACK_STOPWATCH
            bool "M5Stack StopWatch (ESP32-S3, round touch AMOLED)"
            depends on IDF_TARGET_ESP32S3

        config MUSE_BOARD_M5STACK_CORES3
            bool "M5Stack CoreS3 (ESP32-S3, 320x240 touch LCD, speaker and microphones)"
            depends on IDF_TARGET_ESP32S3

        config MUSE_BOARD_M5STACK_CORE2
            bool "M5Stack Core2 v1.0 (ESP32, touch LCD, touch-strip talk)"
            depends on IDF_TARGET_ESP32
        config MUSE_BOARD_FNK0104B
            bool "Freenove FNK0104B (ESP32-S3, 240x320 touch LCD, ES8311 speaker and mic)"
            depends on IDF_TARGET_ESP32S3
        config MUSE_BOARD_GUITION_JC3248W535
            bool "Guition JC3248W535 (ESP32-S3, 3.5\" 320x480 touch LCD, speaker)"
            depends on IDF_TARGET_ESP32S3

        config MUSE_BOARD_WAVESHARE_S3_LCD7
            bool "Waveshare ESP32-S3-Touch-LCD-7 (800x480 touch LCD, no audio)"
            depends on IDF_TARGET_ESP32S3
    endchoice

    config MUSE_ENABLED
        bool
        default y if !MUSE_BOARD_NONE
        select HOMEHUB_DAEMON_REQUESTS   # voice notes and chat over Link's session

    # Always defined, unlike the target-dependent board options, so
    # idf_component.yml rules can select each board's managed components.
    config MUSE_BOARD_ID
        string
        default "waveshare_s3_175c" if MUSE_BOARD_WAVESHARE_S3_175C
        default "waveshare_s3_175" if MUSE_BOARD_WAVESHARE_S3_175
        default "atk_dnesp32s3_box0" if MUSE_BOARD_ATK_DNESP32S3_BOX0
        default "aipi" if MUSE_BOARD_AIPI
        default "espressif_box_3" if MUSE_BOARD_ESPRESSIF_BOX_3
        default "waveshare_c6_18" if MUSE_BOARD_WAVESHARE_C6_18
        default "sensecap_watcher" if MUSE_BOARD_SENSECAP_WATCHER
        default "m5stack_sticks3" if MUSE_BOARD_M5STACK_STICKS3
        default "m5stack_stickc_plus2" if MUSE_BOARD_M5STACK_STICKC_PLUS2
        default "m5stack_cardputer_adv" if MUSE_BOARD_M5STACK_CARDPUTER_ADV
        default "m5stack_stopwatch" if MUSE_BOARD_M5STACK_STOPWATCH
        default "m5stack_cores3" if MUSE_BOARD_M5STACK_CORES3
        default "m5stack_core2" if MUSE_BOARD_M5STACK_CORE2
        default "fnk0104b" if MUSE_BOARD_FNK0104B
        default "guition_jc3248w535" if MUSE_BOARD_GUITION_JC3248W535
        default "waveshare_s3_lcd7" if MUSE_BOARD_WAVESHARE_S3_LCD7
        default "none"

    # The Muse tools' serial port: the console UART behind the board's USB
    # bridge, where the chip's own USB Serial/JTAG isn't wired to a connector
    # (the Watcher's USB-C goes to a CH342) or the chip has none.
    config MUSE_CONSOLE_UART
        bool
        default y if MUSE_BOARD_SENSECAP_WATCHER || MUSE_BOARD_WAVESHARE_S3_LCD7 || !SOC_USB_SERIAL_JTAG_SUPPORTED

    # A board overlay can raise this for a quiet speaker.
    config MUSE_DEFAULT_VOLUME
        int "Speaker volume until one is chosen in settings (percent)"
        range 0 100
        default 70

    config MUSE_WATCHER_CAMERA
        bool "SenseCAP Watcher camera capture and live preview"
        depends on MUSE_BOARD_SENSECAP_WATCHER && SPIRAM
        default n
        help
            Enable the camera.capture Home Link command and the wheel
            double-click camera preview. Camera buffers and tasks consume
            memory and preview decoding shares CPU time with voice and Link.
            Leave disabled to build without camera support.

    config MUSE_CJK_FONT
        bool "Show Chinese, Japanese and Korean in captions"
        depends on MUSE_ENABLED
        default n
        help
            Captions fall back to GNU Unifont's 16x16 bitmaps for CJK
            punctuation, kana, the CJK Unified Ideographs, fullwidth forms,
            Hangul jamo and Hangul syllables that the ASCII caption font
            lacks. Small screens, whose captions are two lines of 8 px
            text, show a reply with CJK in it one 16 px line at a time.
            Takes about 1.2 MB of flash and no RAM. Without it those
            characters show as boxes.

    config MUSE_CJK_FONT_NOTO
        bool "Draw CJK captions with Noto Sans SC instead of Unifont"
        depends on MUSE_CJK_FONT
        default n
        help
            Anti-aliased Noto Sans SC Medium at 16 px in place of Unifont's
            1-bit bitmaps, in the same 16 px cell. Covers the 6763 hanzi of
            GB2312 rather than every CJK Unified Ideograph, and no Hangul:
            rarer characters and Korean show as boxes. Takes about 910 KB of
            flash, against about 1.2 MB.

    config MUSE_LATIN_FONT
        bool "Show Vietnamese and other accented letters in captions"
        depends on MUSE_ENABLED && !MUSE_UI_FREEINK
        default n
        help
            Without it, captions show accented Latin letters as their plain
            ones. With it, a caption with any in it (Latin-1, Latin
            Extended-A, the horned O and U, and Vietnamese's U+1EA0-1EF9)
            shows in GNU Unifont's 8x16 bitmaps, the whole caption in that
            one font. Small screens show such a caption one 16 px line at a
            time. Takes about 10 KB of flash and no RAM.

    choice MUSE_UI_LANGUAGE
        prompt "Language of the screen's own text"
        depends on MUSE_ENABLED && !MUSE_UI_FREEINK
        default MUSE_UI_LANG_EN
        help
            The state label ("READY") and the captions the firmware shows
            itself ("CAN'T REACH MUSE"). Muse's replies are in whatever
            language you speak to it, and the serial console stays in
            English for the tools that read it. The button menu and the
            pairing card are translated; the touch boards' settings pages
            aren't yet.

        config MUSE_UI_LANG_EN
            bool "English"

        config MUSE_UI_LANG_VI
            bool "Vietnamese"
            select MUSE_LATIN_FONT
    endchoice

    config MUSE_JC3248W535_MIC_GPIO
        int "JC3248W535: GPIO for an external I2S mic's data (SD) line"
        depends on MUSE_BOARD_GUITION_JC3248W535
        range -1 48
        default -1
        help
            The board has a speaker amp but no microphone. Wire an I2S MEMS
            mic such as an INMP441 to the speaker's clocks (SCK to GPIO42, WS
            to GPIO2), L/R to GND, power to 3.3 V, and its SD line to a free
            GPIO, and set that GPIO here. -1 leaves push-to-talk recording
            silence.

    config MUSE_HATCH
        bool "Muse's own voice session"
        depends on MUSE_ENABLED
        default y if SPIRAM
        default n
        help
            Push-to-talk turns go over a voice session of Muse's own, to the
            VM Home Link is paired with or one set up on the device with a
            device token. Replies are text, shown as captions; start_tts in
            muse_chat_session.cpp is where a TTS API of your own can speak
            them. Needs PSRAM. Without it, voice notes go over Home Link's own
            session to its paired VM and replies are shown as text.

    config MUSE_REALTIME_VOICE
        bool "Live voice calls with Muse (experimental)"
        depends on (MUSE_HATCH || HOMEHUB_VOICE) && SPIRAM
        default n
        help
            A tap on the talk button starts a live voice call with Muse over
            the voice session; the next press hangs up. Holding the button
            still sends a voice note. On the StopWatch, holding yellow talks
            in a call instead, blue hangs up, and voice notes are a Sound
            setting. The mic is shut while Muse is talking
            unless the board's audio chip confirms echo cancellation (the
            Home Assistant Voice PE's XMOS), so you take turns. The call
            also ends when Muse ends it, when nothing has been said or
            played for the idle limit, or at the length limit. Muse's VM
            has to accept voice calls from this gadget's credentials.

if MUSE_REALTIME_VOICE

    config MUSE_REALTIME_VOICE_APP_ID
        string "App ID the voice session connects as"
        default "hatch-web"
        help
            Sent as app_id when the voice session connects, which is where
            Muse's VM takes the app identity for every request on that
            connection: calls, and voice notes and typed messages too (it
            drops a per-request x-app-id). A call is refused without one. A
            positive 64-bit app ID, or "hatch-web", the web app's. Empty
            sends none. Builds without calls send none either.

    config MUSE_REALTIME_VOICE_IDLE_S
        int "Hang up after this many quiet seconds"
        range 15 1800
        default 45
        help
            Nothing said and nothing audible from Muse for this long ends
            the call. The server may enforce a shorter idle limit.

    config MUSE_REALTIME_VOICE_MAX_S
        int "Longest call, in seconds"
        range 60 7200
        default 900

    config MUSE_REALTIME_VOICE_GREETING
        bool "Muse says hello when a call starts"
        default n

    config MUSE_REALTIME_VOICE_AEC_DUPLEX
        bool "Keep the mic open while Muse talks if echo is cancelled"
        depends on HOMEHUB_VOICE
        default y
        help
            On the Voice PE, when the XMOS reports at start-up that its
            output is echo-cancelled, the call is full duplex and you can
            talk over Muse. Otherwise, and on other boards, the mic is shut
            while Muse is audibly talking and for a moment after.

endif

endmenu
```
